## boards/powerlabs/pai_mobility_controller/board.yml
```yaml
board:
  name: pai_mobility_controller
  full_name: PAI Mobility Controller
  vendor: powerlabs
  socs:
    - name: stm32g473xx
```

## boards/powerlabs/pai_mobility_controller/pai_mobility_controller_defconfig
```kconfig
#
# Copyright (c) 2023 Andreas Sandberg
#
# SPDX-License-Identifier: Apache-2.0
#

CONFIG_CLOCK_CONTROL=y

CONFIG_ARM_MPU=y
CONFIG_HW_STACK_PROTECTION=y
```

## boards/powerlabs/pai_mobility_subcontroller/Kconfig.pai_mobility_subcontroller
```kconfig
# Copyright (c) 2023 Andreas Sandberg
# SPDX-License-Identifier: Apache-2.0

config BOARD_PAI_MOBILITY_SUBCONTROLLER
	select SOC_STM32G473XX

config ENABLE_PAI_MOBILITY_SUBCONTROLLER_RGB_LED
	bool "Enable the RGB led of the subcontroller"
	default y
	help
		Enable the RGB led of the subcontroller by turning the MOSFET connected to the cathode on.

config ENABLE_PAI_MOBILITY_SUBCONTROLLER_RGB_LED_SETUP_PRIORITY
	int "RGB LED enable pin setup priority"
	default 50
	help
	  Priority used to setup the enable pin of the RGB LED . 


config PAI_MOBILITY_SETUP_TPL5010_PRIORITY
	int "TPL5010 setup priority"
	default 5
	help
	  Priority used to setup TPL5010 watchdog chip.
```

## boards/powerlabs/pai_mobility_subcontroller/board.yml
```yaml
board:
  name: pai_mobility_subcontroller
  full_name: PAI Mobility Subcontroller
  vendor: powerlabs
  socs:
    - name: stm32g473xx
```

## drivers/can/Kconfig.uart_to_can
```kconfig
module = CAN_UART_TO_CAN
module-str = can_uart_to_can

config CAN_UART_TO_CAN
    bool "Enable can_uart_to_can driver"
    default y
	depends on DT_HAS_POWERLABS_UART_TO_CAN_ENABLED
    select UART
    help
        Enable can_uart_to_can driver

config CAN_UART_TO_CAN_ASYNC_API
    bool "Use UART asynchronous API in can_uart_to_can"
    depends on UART_ASYNC_API
    help
      Use UART asynchronous API for can_uart_to_can.
      When disabled, can_uart_to_can uses UART interrupt-driven API.

config UART_TO_CAN_USE_SYS_WORK_Q
    bool "Uart to can to use ths system work queue"
    default y
    help 
        Should the work queue used by uart to can be the system q or a user defined work q. Useful for when a system that run on the work queue depends on the uart to can.
        If false, a function "struct k_work_q *uart_to_can_get_work_q(void)" needs to be defined to return a pointer to the work queue to be used. 

config CAN_UART_TO_CAN_RX_BUFFER_COUNT
    int "Number of uart_to_can_frame to be used"
    default 20
    help
      Number of uart_to_can_frame to be used. The total number of bytes is CAN_UART_TO_CAN_RX_BUFFER_COUNT * MAX_UART_CAN_FRAME.
```

## subsys/canbus/isotp_runtime_context/Kconfig
```kconfig
module = ISOTP_RUNTIME_CONTEXT
module-str = isotp_runtime_context

config $(module)
    bool "Enable isotp_runtime_context"
    default n
    select ISOTP
    help
        Enable isotp_runtime_context

config ISOTP_RUNTIME_CONTEXT_MAX_SEND_LEN
    int "The max data len that can be sent by isotp context"
    default 50
    help
        The max data len that can be sent by isotp context

config ISOTP_RUNTIME_CONTEXT_SEND_TTL_MS
    int "Milliseconds a queued send stays valid"
    default 10000
    help
    A message that could not be delivered within this time; .

config ISOTP_RUNTIME_CONTEXT_QUEUE_SIZE
    int "The number of send  data that can be queue at a time"
    default 5
    help
        The number of send  data that can be queue at a time


if $(module)
    source "subsys/logging/Kconfig.template.log_config"
endif
```
